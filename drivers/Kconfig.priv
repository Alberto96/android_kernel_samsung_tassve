## drivers/Kconfig.priv
```kconfig
menuconfig BRCM_MODULES_PRIV
	tristate "Broadcom Proprietary Kernel Modules"
	depends on BRCM_MODULES
	default N
	help
	  Broadcom Proprietary Kernel Modules

if BRCM_MODULES_PRIV

# source Kconfig for proprietary drivers here
# add "depends on BRCM_MODULES && BRCM_MODULES_PRIV" to Kconfig
source "drivers/video/bmem/Kconfig"
source "drivers/video/hantro/Kconfig"
source "drivers/video/ge/Kconfig"

source "drivers/char/brcm/hal_cam/Kconfig"
source "drivers/char/brcm/camacq/Kconfig"

source "drivers/char/sec/dpram/Kconfig"

source "drivers/char/brcm/fuse_ipc/Kconfig"
source "drivers/char/brcm/fuse_net/Kconfig"
source "drivers/char/brcm/fuse_at/Kconfig"
source "drivers/char/brcm/fuse_ril/Kconfig"
source "drivers/char/brcm/fuse_pdp/Kconfig"
source "drivers/char/brcm/fuse_rpc/Kconfig"
source "drivers/char/brcm/fuse_log/Kconfig"
source "drivers/char/brcm/fuse_sysparm/Kconfig"
source "drivers/char/brcm/fuse_vsp/Kconfig"
source "drivers/char/brcm/xscript/Kconfig"
source "drivers/char/brcm/v3d/Kconfig"

source "drivers/sound/brcm/alsa/Kconfig"
source "drivers/sound/brcm/alsa_athena/Kconfig"
# Headset module
source "drivers/sound/brcm/headset/Kconfig"
source "drivers/gps/brcm/Kconfig"

# video telephony
config VIDEO_TELEPHONY_ENABLE
	boolean "Video Telephony support"
	depends on BRCM_MODULES && BRCM_MODULES_PRIV
	default N
	help
	  Video Telephony support

#OEM RIL
config OEM_RIL_ENABLE
	boolean "OEM RIL support"
	depends on BRCM_MODULES && BRCM_MODULES_PRIV
	default N
	help
	  OEM RIL support

# AGPS control plane 
config BRCM_AGPS_CONTROL_PLANE_ENABLE
	boolean "AGPS control plane support"
	depends on BRCM_MODULES && BRCM_MODULES_PRIV
	default N
	help
	  AGPS control plane support

endif # BRCM_MODULES_PRIV
```

## drivers/samsung/Kconfig
```kconfig
#
#
#

menuconfig SAMSUNG_MODULES
	tristate "Samsung Kernel Modules"
	default y
	help
	  Say Y to enable Samsung kernel modules. j4fs and param
	  modules are included.

menuconfig J4FS
	tristate "Samsung J4FS support"
	depends on SAMSUNG_MODULES
	default y
	help
	  Say Y to enable Samsung J4FS support.
```
